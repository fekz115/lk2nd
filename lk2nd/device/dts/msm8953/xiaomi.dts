// SPDX-License-Identifier: GPL-2.0-only

#include <skeleton64.dtsi>
#include <lk2nd.dtsi>

/ {
	qcom,msm-id = <QCOM_ID_MSM8953 0>;
	qcom,board-id = <0x1000b 0x8>;
};

&lk2nd {
	vince {
		model = "Xiaomi Redmi 5 Plus";
		compatible = "xiaomi,vince";
		lk2nd,match-bootloader = "*DAISY1.0*";
		
		qcom,board-id = <0x1000b 0x8>;
	};
};
